## Kconfig
```kconfig
mainmenu "VR-Pilot-PRO"

config VRP_WITH_ROS2
    bool "Enable ROS2 DDS bridge"
    default y

config VRP_ENABLE_VTOL
    bool "Enable VTOL vehicle"
    default y

config VRP_ENABLE_SUBSEA
    bool "Enable Subsea vehicle"
    default y

config VRP_MINIMIZE_FEATURES
    bool "Minimize features for 1MB boards"
    default n

config VRP_TARGET_ESP32
    bool "Enable ESP32 HAL target"
    default n
    help
      Build with HAL_ESP32 backend and VREsp32 board hwdef.

config VRP_BUILD_ID
    string "Build identifier"
    default "dev"
```
